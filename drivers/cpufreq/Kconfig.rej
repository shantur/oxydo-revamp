## drivers/cpufreq/Kconfig.rej
```kconfig
diff a/drivers/cpufreq/Kconfig b/drivers/cpufreq/Kconfig	(rejected hunks)
@@ -196,6 +202,12 @@ config CPU_FREQ_GOV_INTERACTIVE
 config CPU_FREQ_GOV_N3OCOLD
 	tristate "'n3ocold' cpufreq policy governor"
 
config CPU_FREQ_GOV_SMARTMAX
	tristate "'smartmax' cpufreq policy governor"
	select CPU_FREQ_TABLE
	help
	  'smartmax' combined ondemand and smartass2

 config CPU_FREQ_GOV_CONSERVATIVE
 	tristate "'conservative' cpufreq governor"
 	depends on CPU_FREQ
```
